## drivers/misc/lazydma/Kconfig
```kconfig
# SPDX-License-Identifier: GPL-2.0-only
#
# Lazy DMA configuration
#

config LAZYDMA
	tristate "Lazy DMA tracking and VM-exit support"
	depends on X86_64 && PCI
	help
	  This driver provides DMA tracking and VM-exit based page management
	  for virtualized environments. It tracks DMA mappings at PMD (2MB page)
	  granularity and triggers VM-exits to coordinate with the hypervisor.

	  The driver hooks into the kernel's DMA operations to monitor when
	  physical memory is mapped for DMA access. When a new PMD is mapped,
	  it triggers a VM-exit to notify the host, which can then take
	  appropriate actions (e.g., pinning pages, updating EPT mappings).

	  To use this driver, you need to specify reserved memory regions via
	  kernel command line parameters:
	    lazydma_track=addr,size  - Tracking memory region
	    lazydma_mmio=addr,size   - MMIO region for VM-exit triggers

	  Say Y or M if you are running in a VM and want to use lazy DMA
	  tracking features. If unsure, say N.

# used in guest
config LAZYDMA_HUGEPAGE_PMD
	tristate "Lazy DMA use hugepage in EPT"
	depends on LAZYDMA
	help
		Lazy DMA use hugepage in EPT

# used in host
config LAZYDMA_PTE_MODE
	tristate "Lazy DMA use PTE in EPT"
	depends on LAZYDMA
	help
		Lazy DMA use PTE in EPT
```

## drivers/misc/pvsched/Kconfig
```kconfig
config PV_SCHED_HOST
	tristate "Para-virtualized Scheduler Host-side support"
	depends on X86_64 || ARM64
	default n
	help
	  This option enables a character device (/dev/pvsched) that allows
	  QEMU to coordinate scheduling with the host kernel. It maps a 
	  specific user-space address range into the kernel for direct 
	  metadata access.

	  To compile this driver as a module, choose M here: the
	  module will be called pvsched_host.

config PV_SCHED_GUEST
	tristate "Para-virtualized Scheduler Guest-side support"
	depends on X86_64 || ARM64
	default n
	help
	  TODO
```
